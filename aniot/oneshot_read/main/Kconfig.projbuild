## aniot/oneshot_read/main/Kconfig.projbuild
```kconfig
menu "Example Configuration"

    config EXAMPLE_N
        int "Number of samples to average"
        default 5
        help
            Number of samples to average.

endmenu
```

## aniot/sampler/components/mock-wifi/Kconfig.projbuild
```kconfig
menu "MOCK_WIFI Configuration"

    config CONNECT_DELAY
        int "CONNECT DELAY (s)"
        default 5
        help
            Delay seconds between wifi_connect() call and sending event back

    config IP_DELAY
        int "IP DELAY (s)"
        default 3
        help
            Delay seconds between WIFI_MOCK_EVENT_WIFI_CONNECTED and WIFI_MOCK_EVENT_WIFI_GOT_IP events
    
    config DISCONNECT_DELAY
        int "DISCONNECT_DELAY (s)"
        default 15
        help
            Delay seconds between WIFI_MOCK_EVENT_WIFI_CONNECTED and WIFI_MOCK_EVENT_WIFI_DISCONNECTED events

endmenu
```

## aniot/sampler/main/Kconfig.projbuild
```kconfig
menu "Example Configuration"

    config SENSOR_SAMPLING_PERIOD
        int "Sensor sampling period in s"
        range 0 3600
        default 1
        help
            Define the sensor sampling period in seconds.

    config BUTTON_SAMPLING_PERIOD
        int "Button sampling period in s"
        range 0 3600
        default 1
        help
            Define the button sampling period in seconds.

endmenu
```

## rp1/hello_world/main/Kconfig.projbuild
```kconfig
menu "Example Configuration"

    config TASK_1_MS_TO_DELAY
        int "Delay period in ms for task 1"
        range 10 3600000
        default 1000
        help
            Define the delay period in milliseconds for task 1.


    config TASK_2_MS_TO_DELAY
        int "Delay period in ms for task 2"
        range 10 3600000
        default 1000
        help
            Define the delay period in milliseconds for task 2.

endmenu
```
